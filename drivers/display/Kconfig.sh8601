## drivers/display/Kconfig.sh8601
```kconfig
# Copyright (c) 2025 Leonardo Bispo
# SPDX-License-Identifier: Apache-2.0

menuconfig SH8601
	bool "SH8601 display driver"
	default y
	depends on DT_HAS_SINOWEALTH_SH8601_ENABLED
	select SPI
	help
	  Enable driver for Sinowealth SH8601 466x466 round LCD display controller.
	  This driver supports SPI interface mode.
```

## dts/bindings/display/sinowealth,sh8601.yaml
```yaml
# Copyright (c) 2025 Leonardo Bispo
# SPDX-License-Identifier: Apache-2.0

title: Sinowealth SH8601 Display Controller

description: |
  Sinowealth SH8601 466x466 round LCD display controller.
  Supports standard SPI interface mode.

compatible: "sinowealth,sh8601"

include: [spi-device.yaml, display-controller.yaml]

properties:
  reset-gpios:
    type: phandle-array
    description: GPIO for hardware reset signal (active low)

  mirror-x:
    type: boolean
    description: Mirror display horizontally

  mirror-y:
    type: boolean
    description: Mirror display vertically
```
